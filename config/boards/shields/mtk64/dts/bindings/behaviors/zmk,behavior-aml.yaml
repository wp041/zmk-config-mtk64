## config/boards/shields/mtk64/dts/bindings/behaviors/zmk,behavior-aml.yaml
```yaml
# Copyright (c) 2026 The ZMK Contributors
# SPDX-License-Identifier: MIT

description: Behavior to control Auto Mouse Layer (AML) ON/OFF state

compatible: "zmk,behavior-aml"

include: zero_param.yaml

properties:
  cmd:
    type: int
    required: true
    enum:
      - 0 # TOG
      - 1 # ON
      - 2 # OFF
      - 3 # THR_INC
      - 4 # THR_DEC
    description: |
      Command type:
      0: Toggle AML state
      1: Turn AML ON
      2: Turn AML OFF
      3: Increase activation movement threshold
      4: Decrease activation movement threshold
  step:
    type: int
    required: false
    default: 15
    description: THR_INC / THR_DEC の 1 回あたりの増減量
```

## config/boards/shields/mtk64/dts/bindings/input_processors/zmk,input-processor-aml.yaml
```yaml
# Copyright (c) 2026 The ZMK Contributors
# SPDX-License-Identifier: MIT

description: |
  Auto Mouse Layer (takashicompany 方式).
  param1 = 有効にするレイヤー, param2 = CLICKABLE 状態のタイムアウト (ms)

compatible: "zmk,input-processor-aml"

include: ip_two_param.yaml

properties:
  require-prior-idle-ms:
    type: int
    required: false
    default: 0
    description: 最後のキー入力からこの時間が経つまではレイヤーを有効にしない (0 で無効)

  activation-movement:
    type: int
    required: false
    default: 1
    description: WAITING 中の累積移動量 (|x|+|y| のセンサーカウント) がこの値に達したらレイヤーを有効にする。実行時に &aml_thr_inc / &aml_thr_dec で変更可 (NVS 保存)

  activation-window-ms:
    type: int
    required: false
    default: 50
    description: WAITING 開始からこの時間を過ぎた後に動きが途切れたら累積をリセットする

  activation-gap-ms:
    type: int
    required: false
    default: 10
    description: この時間以上モーションが来なければ「動きが途切れた」とみなす

  click-lock-movement:
    type: int
    required: false
    default: 0
    description: クリック押下直後、この移動量ぶんのボール入力を無視する (after_click_lock_movement)

  scroll-layer:
    type: int
    required: false
    default: -1
    description: このレイヤーが有効な間は SCROLLING とみなし、タイムアウトもキー入力による解除も行わない

  excluded-positions:
    type: array
    required: false
    default: []
    description: 指定した場合、これ以外のキー位置の押下でもレイヤーを解除する (通常は空でよい。修飾キー以外のキーコード入力で解除される)
```

## config/boards/shields/mtk64/dts/bindings/input_processors/zmk,input-processor-scroll-axis-lock.yaml
```yaml
# Copyright (c) 2026 The ZMK Contributors
# SPDX-License-Identifier: MIT

description: スクロール時に縦横どちらか優勢な軸だけを通す (縦優先: |y|*2 > |x|)

compatible: "zmk,input-processor-scroll-axis-lock"

include: ip_zero_param.yaml
```
